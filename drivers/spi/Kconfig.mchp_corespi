## drivers/spi/Kconfig.mchp_corespi
```kconfig
# Microchip Polarfire SOC SPI

# Copyright (c) 2025 Microchip Technology Inc.
# SPDX-License-Identifier: Apache-2.0

config SPI_MCHP_CORESPI
	bool "Microchip Polarfire SOC Core SPI driver"
	default y
	depends on DT_HAS_MICROCHIP_MPFS_SPI_ENABLED
	help
	  Enable support for the Microchip FPGA CoreSPI driver.
```

## dts/bindings/spi/microchip,mpfs-spi.yaml
```yaml
# Copyright (c) 2022 Microchip Inc.
# SPDX-License-Identifier: Apache-2.0

description: Microchip Polarfire SOC SPI controller

compatible: 
 - "microchip,mpfs-spi" 
 - "microchip,corespi-rtl-v5"

include: [spi-controller.yaml, reset-device.yaml]

properties:
  reg:
    required: true

  interrupts:
    required: true

  cs-gpios:
    required: true
```
